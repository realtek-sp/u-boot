## board/realtek/rts493xa/Kconfig
```kconfig
choice
	prompt "DDR Type Selection"
	default RTS493xA_QFN88_DDR3_1GBIT
	help
	  Select ddr type

config RTS493xA_QFN88_DDR3_1GBIT
	bool "QFN88 DDR3 MCM(1Gbit)"
	depends on (TARGET_ASIC || TARGET_EMULATOR)
	select QFN88_PACKAGE
	help
	 Enable option for QFN88 DDR3 1Gbit

config RTS493xA_QFN88_DDR3_2GBIT
	bool "QFN88 DDR3 MCM(2Gbit)"
	depends on (TARGET_ASIC || TARGET_EMULATOR)
	select QFN88_PACKAGE
	help
	 Enable option for QFN88 DDR3 2Gbit

config RTS493xA_DDR_H5TQ2G
	bool "DDR3 H5TQ2G(Hynix 256MB)"
	depends on TARGET_FPGA
	help
	  Enable option for DDR H5TQ2G

endchoice

choice
	prompt "DDR Speed Selection"
	default RTS493xA_DDR_1066
	depends on (TARGET_ASIC || TARGET_EMULATOR)
	help
	  Select ddr clock

config RTS493xA_DDR_1066
	bool "DDR-1066"
	help
	  Select ddr dqs clock to 1066/2

config RTS493xA_DDR_1333
	bool "DDR-1333"
	help
	  Select ddr dqs clock to 1333/2

config RTS493xA_DDR_1600
	bool "DDR-1600"
	help
	  Select ddr dqs clock to 1600/2

config RTS493xA_DDR_1866
	bool "DDR-1866"
	help
	  Select ddr dqs clock to 1866/2

config RTS493xA_DDR_2133
	bool "DDR-2133"
	help
	  Select ddr dqs clock to 2133/2

endchoice

choice
	prompt "Boot Mode Selection"
	default RTS493XA_BOOT_NORMAL
	help
	  Select the boot mode for the RTS493xA series. This choice determines
	  how the system initializes and what security measures are in place
	  during the boot process. Choose the mode that best fits your
	  environment and security requirements.

config RTS493XA_BOOT_NORMAL
	bool "Boot mode normal"
	help
	  Select this option to boot the system in normal mode. In this mode,
	  the system will initialize without additional security checks. This
	  mode is suitable for development and testing environments where
	  security is not a primary concern.

config RTS493XA_BOOT_SECURE
	bool "Boot mode secure"
	select FIT_SIGNATURE
	help
	  Select this option to boot the system in secure mode. In this mode,
	  additional security measures are enforced during the boot process,
	  such as verifying the integrity of the bootloader and kernel images.
	  This mode is recommended for production environments where security
	  is critical to prevent unauthorized access and ensure system integrity.

config RTS493XA_BOOT_CRYPTO
	bool "Boot mode crypto"
	select CRYPTO_BOOT
	select CBC_MODE
	select AES_256
	help
	  Select this option to boot the system in crypto mode. This mode
	  provides enhanced security by incorporating cryptographic checks
	  during the boot process. It ensures that all boot components are
	  authenticated and have not been tampered with. This mode is ideal
	  for environments that require high levels of security and data
	  protection.

config RTS493XA_BOOT_SECURE_CRYPTO
	bool "Boot mode secure and crypto"
	select FIT_SIGNATURE
	select CRYPTO_BOOT
	select CBC_MODE
	select AES_256
	help
	  Select this option to boot the system with both secure and crypto
	  modes enabled. This configuration enforces the highest level of
	  security by combining the features of both secure and crypto modes.
	  During the boot process, the system will perform comprehensive
	  security checks, including verifying the integrity and authenticity
	  of the bootloader and kernel images using cryptographic methods.
	  This mode is ideal for environments that demand maximum security
	  and data protection, ensuring that all boot components are
	  authenticated and protected against unauthorized modifications.

endchoice
```

## drivers/pinctrl/realtek/Kconfig
```kconfig
# SPDX-License-Identifier: GPL-2.0-only

config PINCTRL_RTS493xA
	bool "Pinctrl and GPIO driver for Realtek rts493xa series"
	depends on DM && PINCTRL_GENERIC
	help
	  Support pin muxing and pin configuration on
	  Realtek rts493xa SoC.

	  The rts493xa contains many GPIO pins. Most of them are
	  multiplexed with other system functions. These pins can
	  be configured as either GPIO pin or alternate function.
	  It also supports basic configurations such as pull up/down,
	  drive-strength, and slew rate control for some of the pins.
```
